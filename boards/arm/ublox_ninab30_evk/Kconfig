## boards/arm/ublox_ninab30_evk/Kconfig
```kconfig
# Kconfig - u-blox EVK-NINA-B30x board configuration
#
# Copyright (c) 2016 Nordic Semiconductor ASA
#
# SPDX-License-Identifier: Apache-2.0

if BOARD_UBLOX_NINAB30_EVK

config BOARD_ENABLE_DCDC
        bool "Enable DCDC mode"
        select SOC_DCDC_NRF52X
        default y

endif # BOARD_UBLOX_NINAB30_EVK
```

## boards/arm/ublox_ninab30_evk/Kconfig.board
```kconfig
# Kconfig - u-blox EVK-NINA-B30x board configuration
#
# Copyright (c) 2016 Nordic Semiconductor ASA
#
# SPDX-License-Identifier: Apache-2.0

config  BOARD_UBLOX_NINAB30_EVK
	bool "u-blox EVK-NINA-B30x"
	depends on SOC_NRF52840_QIAA
```
